## cargo-web/conf/local.conf
```bitbake
include "application"

slick.dbs.default {
   profile = "slick.jdbc.PostgresProfile$"
   db {
      properties.driver = "org.postgresql.Driver"
      dataSourceClass = "slick.jdbc.DatabaseUrlDataSource"
      driver = "org.postgresql.Driver"
      url = "jdbc:postgresql://localhost:15432/cargo"
      username = postgres
      password = "paaske"
      logSql = true
   }
}
```
